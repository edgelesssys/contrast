## packages/by-name/microsoft/kata-kernel-uvm/src/fs/tarfs/Kconfig
```kconfig
config TARFS_FS
	tristate "msft tardev snapshotter guest support"
	default y
	help
	  If you say Y here, you will get tardev / tarfs support on the
	  guest side.

	  See <https://github.com/microsoft/kata-containers/tree/msft-main/src/tarfs> for more information.

	  If unsure, say Y.
```
